## Documentation/devicetree/bindings/interconnect/qcom,bcm-voter.yaml
```yaml
# SPDX-License-Identifier: GPL-2.0
%YAML 1.2
---
$id: http://devicetree.org/schemas/interconnect/qcom,bcm-voter.yaml#
$schema: http://devicetree.org/meta-schemas/core.yaml#

title: Qualcomm BCM-Voter Interconnect

maintainers:
  - David Dai <daidavid1@codeaurora.org>

description: |
    The Bus Clock Manager (BCM) is a dedicated hardware accelerator
    that manages shared system resources by aggregating requests
    from multiple Resource State Coordinators (RSC). Interconnect
    providers are able to vote for aggregated thresholds values from
    consumers by communicating through their respective RSCs.

properties:
  compatible:
    enum:
      - qcom,sc7180-bcm-voter
      - qcom,sdm845-bcm-voter

required:
  - compatible

additionalProperties: false

examples:
  - |
    apps_rsc: interconnect@179c0000 {
        compatible = "qcom,rpmh-rsc";

        apps_bcm_voter: bcm_voter {
            compatible = "qcom,sdm845-bcm-voter";
        };
    };

    disp_rsc: interconnect@179d0000 {
        compatible = "qcom,rpmh-rsc";

        disp_bcm_voter: bcm_voter {
            compatible = "qcom,sdm845-bcm-voter";
        };
    };
```

## Documentation/devicetree/bindings/interconnect/qcom,sc7180.yaml
```yaml
# SPDX-License-Identifier: GPL-2.0
%YAML 1.2
---
$id: http://devicetree.org/schemas/interconnect/qcom,sc7180.yaml#
$schema: http://devicetree.org/meta-schemas/core.yaml#

title:  Qualcomm SC7180 Network-On-Chip Interconnect

maintainers:
  - David Dai <daidavid1@codeaurora.org>

description: |
   SC7180 interconnect providers support system bandwidth requirements through
   RPMh hardware accelerators known as Bus Clock Manager (BCM). The provider is
   able to communicate with the BCM through the Resource State Coordinator (RSC)
   associated with each execution environment. Provider nodes must point to at
   least one RPMh device child node pertaining to their RSC and each provider
   can map to multiple RPMh resources.

properties:
  reg:
    maxItems: 1

  compatible:
    enum:
      - qcom,sc7180-aggre1-noc
      - qcom,sc7180-aggre2-noc
      - qcom,sc7180-camnoc-virt
      - qcom,sc7180-compute-noc
      - qcom,sc7180-config-noc
      - qcom,sc7180-dc-noc
      - qcom,sc7180-gem-noc
      - qcom,sc7180-ipa-virt
      - qcom,sc7180-mc-virt
      - qcom,sc7180-mmss-noc
      - qcom,sc7180-npu-noc
      - qcom,sc7180-qup-virt
      - qcom,sc7180-system-noc

  '#interconnect-cells':
    const: 1

  qcom,bcm-voters:
    $ref: /schemas/types.yaml#/definitions/phandle-array
    description: |
      List of phandles to qcom,bcm-voter nodes that are required by
      this interconnect to send RPMh commands.

  qcom,bcm-voter-names:
    $ref: /schemas/types.yaml#/definitions/string-array
    description: |
      Names for each of the qcom,bcm-voters specified.

required:
  - compatible
  - reg
  - '#interconnect-cells'
  - qcom,bcm-voters

additionalProperties: false

examples:
  - |
      #include <dt-bindings/interconnect/qcom,sc7180.h>

      config_noc: interconnect@1500000 {
            compatible = "qcom,sc7180-config-noc";
            reg = <0 0x01500000 0 0x28000>;
            #interconnect-cells = <1>;
            qcom,bcm-voters = <&apps_bcm_voter>;
      };

      system_noc: interconnect@1620000 {
            compatible = "qcom,sc7180-system-noc";
            reg = <0 0x01620000 0 0x17080>;
            #interconnect-cells = <1>;
            qcom,bcm-voters = <&apps_bcm_voter>;
      };

      mc_virt: interconnect@1630000 {
            compatible = "qcom,sc7180-mc-virt";
            reg = <0 0x01630000 0 0x4000>;
            #interconnect-cells = <1>;
            qcom,bcm-voters = <&apps_bcm_voter>;
      };

      qup_virt: interconnect@1650000 {
            compatible = "qcom,sc7180-qup-virt";
            reg = <0 0x01650000 0 0x4000>;
            #interconnect-cells = <1>;
            qcom,bcm-voters = <&apps_bcm_voter>;
      };

      aggre1_noc: interconnect@16e0000 {
            compatible = "qcom,sc7180-aggre1-noc";
            reg = <0 0x016e0000 0 0x15080>;
            #interconnect-cells = <1>;
            qcom,bcm-voters = <&apps_bcm_voter>;
      };

      aggre2_noc: interconnect@1700000 {
            compatible = "qcom,sc7180-aggre2-noc";
            reg = <0 0x01700000 0 0x1f880>;
            #interconnect-cells = <1>;
            qcom,bcm-voters = <&apps_bcm_voter>;
      };

      compute_noc: interconnect@170e000 {
            compatible = "qcom,sc7180-compute-noc";
            reg = <0 0x0170e000 0 0x11880>;
            #interconnect-cells = <1>;
            qcom,bcm-voters = <&apps_bcm_voter>;
      };

      mmss_noc: interconnect@1740000 {
            compatible = "qcom,sc7180-mmss-noc";
            reg = <0 0x01740000 0 0x1c100>;
            #interconnect-cells = <1>;
            qcom,bcm-voters = <&apps_bcm_voter>;
      };

      ipa_virt: interconnect@1e00000 {
            compatible = "qcom,sc7180-ipa-virt";
            reg = <0 0x01e00000 0 0x4000>;
            #interconnect-cells = <1>;
            qcom,bcm-voters = <&apps_bcm_voter>;
      };

      dc_noc: interconnect@9160000 {
            compatible = "qcom,sc7180-dc-noc";
            reg = <0 0x09160000 0 0x03200>;
            #interconnect-cells = <1>;
            qcom,bcm-voters = <&apps_bcm_voter>;
      };

      gem_noc: interconnect@9680000 {
            compatible = "qcom,sc7180-gem-noc";
            reg = <0 0x09680000 0 0x3e200>;
            #interconnect-cells = <1>;
            qcom,bcm-voters = <&apps_bcm_voter>;
      };

      npu_noc: interconnect@9990000 {
            compatible = "qcom,sc7180-npu-noc";
            reg = <0 0x09990000 0 0x1600>;
            #interconnect-cells = <1>;
            qcom,bcm-voters = <&apps_bcm_voter>;
      };

      camnoc_virt: interconnect@ac00000 {
            compatible = "qcom,sc7180-camnoc-virt";
            reg = <0 0x0ac00000 0 0x4000>;
            #interconnect-cells = <1>;
            qcom,bcm-voters = <&apps_bcm_voter>;
      };
```

## Documentation/devicetree/bindings/interconnect/qcom,sdm845.yaml
```yaml
# SPDX-License-Identifier: GPL-2.0
%YAML 1.2
---
$id: http://devicetree.org/schemas/interconnect/qcom,sdm845.yaml#
$schema: http://devicetree.org/meta-schemas/core.yaml#

title:  Qualcomm SDM845 Network-On-Chip Interconnect

maintainers:
  - David Dai <daidavid1@codeaurora.org>

description: |
   SDM845 interconnect providers support system bandwidth requirements through
   RPMh hardware accelerators known as Bus Clock Manager (BCM). The provider is
   able to communicate with the BCM through the Resource State Coordinator (RSC)
   associated with each execution environment. Provider nodes must point to at
   least one RPMh device child node pertaining to their RSC and each provider
   can map to multiple RPMh resources.

properties:
  reg:
    maxItems: 1

  compatible:
    enum:
      - qcom,sdm845-aggre1-noc
      - qcom,sdm845-aggre2-noc
      - qcom,sdm845-config-noc
      - qcom,sdm845-dc-noc
      - qcom,sdm845-gladiator-noc
      - qcom,sdm845-mem-noc
      - qcom,sdm845-mmss-noc
      - qcom,sdm845-system-noc

  '#interconnect-cells':
    const: 1

  qcom,bcm-voters:
    $ref: /schemas/types.yaml#/definitions/phandle-array
    description: |
      List of phandles to qcom,bcm-voter nodes that are required by
      this interconnect to send RPMh commands.

  qcom,bcm-voter-names:
    $ref: /schemas/types.yaml#/definitions/string-array
    description: |
      Names for each of the qcom,bcm-voters specified.

required:
  - compatible
  - reg
  - '#interconnect-cells'
  - qcom,bcm-voters

additionalProperties: false

examples:
  - |
      #include <dt-bindings/interconnect/qcom,sdm845.h>

      mem_noc: interconnect@1380000 {
             compatible = "qcom,sdm845-mem-noc";
             reg = <0 0x01380000 0 0x27200>;
             #interconnect-cells = <1>;
             qcom,bcm-voters = <&apps_bcm_voter>;
      };

      dc_noc: interconnect@14e0000 {
             compatible = "qcom,sdm845-dc-noc";
             reg = <0 0x014e0000 0 0x400>;
             #interconnect-cells = <1>;
             qcom,bcm-voters = <&apps_bcm_voter>;
      };

      config_noc: interconnect@1500000 {
             compatible = "qcom,sdm845-config-noc";
             reg = <0 0x01500000 0 0x5080>;
             #interconnect-cells = <1>;
             qcom,bcm-voters = <&apps_bcm_voter>;
      };

      system_noc: interconnect@1620000 {
             compatible = "qcom,sdm845-system-noc";
             reg = <0 0x01620000 0 0x18080>;
             #interconnect-cells = <1>;
             qcom,bcm-voters = <&apps_bcm_voter>;
      };

      aggre1_noc: interconnect@16e0000 {
             compatible = "qcom,sdm845-aggre1-noc";
             reg = <0 0x016e0000 0 0xd080>;
             #interconnect-cells = <1>;
             qcom,bcm-voters = <&apps_bcm_voter>;
      };

      aggre2_noc: interconnect@1700000 {
             compatible = "qcom,sdm845-aggre2-noc";
             reg = <0 0x01700000 0 0x3b100>;
             #interconnect-cells = <1>;
             qcom,bcm-voters = <&apps_bcm_voter>;
      };

      mmss_noc: interconnect@1740000 {
             compatible = "qcom,sdm845-mmss-noc";
             reg = <0 0x01740000 0 0x1c1000>;
             #interconnect-cells = <1>;
             qcom,bcm-voters = <&apps_bcm_voter>;
      };
```

## Documentation/devicetree/bindings/thermal/qcom-lmh-thermal.txt
```
Limits Management Hardware for Thermal management

The LMH block is a hardware IP for every CPU cluster to monitor rapid changes in
thermal conditions and perform quick thermal mitigation to keep the hardware
within limits. The LMH hardware responds to thermal variation amongst the CPUs
in the cluster by requesting the OSM (frequency scaling) hardware to limit the
clock frequency and voltage.

The LMH (thermal) driver exports a virtual sensor that can be used to set the
thermal limits on the hardware. It also acts as a  platform CPU cooling device,
which registers with the CPU cooling device interface. All CPU device nodes
should reference the corresponding LMH instance in device tree. All CPUs
referencing the same LMH node will be associated with one instance of the
LMH cooling device.

Required Properties:

- compatible:
	Value type: <string>
	Definition: Must be "qcom,lmh"

- reg:
	Value type: <regaddr size >
	Definition: Address range of the LMH DCVS registers.

- interrupts:
	Value type: <interrupt_type interrupt_number interrupt_trigger_type>
	Definition: Should specify irq line for the debug interrupt generated by
			the LMH hardware. LMH hardware will generate this
			interrupt whenever it changes CPU throttling parameters

- qcom,affinity:
	Value type: <u32>
	Definition: Must specify cluster affinity of this hardware instance

- #thermal-sensor-cells : Should be <0>. See ./thermal.txt for a description.

Optional Properties:

- isens_vref-supply:
	Value type: <phandle>
	Definition: Should specify the phandle of the vref regulator used by
			the isens hardware. This active only regulator will be
			enabled by LMH DCVSh.

- isens-vref-settings:
	Value type: <u32 array>
	Definition: Should specify the min voltage(uV), max voltage(uV) and
			max load(uA) for the isens vref regulator. This
			property is valid only if there is valid entry for
			isens_vref-supply.

Example:

	lmh0: limits-hw-thermal@0 {
		compatible = "qcom,lmh";
		interrupts = <GIC_SPI 38 IRQ_TYPE_LEVEL_HIGH>;
		qcom,affinity = <0>;
		isens_vref-supply = <&pm8998_l1_ao>;
		isens-vref-settings = <880000 880000 36000>;
	};

	CPU0: cpu@0 {
		device_type = "cpu";
		compatible = "arm,armv8";
		reg = <0x0 0x0>;
		qcom,lmh-thermal = <&lmh0>;;
	};
```
